## firmware/main/Kconfig.projbuild
```kconfig
menu "Friday assistant"

config FRIDAY_BACKEND_WS_URI
    string "Friday backend WebSocket URI"
    default "wss://192.168.4.38:8000/ws/device/friday-p3a"
    help
        WebSocket endpoint used by this device. The backend must listen on a
        LAN-accessible interface and present a certificate signed by the
        Friday CA embedded in this firmware. Plain ws:// is rejected.

config FRIDAY_DISCOVERY_PORT
    int "Friday backend UDP discovery port"
    range 1024 65535
    default 8334
    help
        UDP port used to discover the backend on the current LAN before falling
        back to FRIDAY_BACKEND_WS_URI.

config FRIDAY_REDISCOVERY_FAILURES
    int "Reconnect failures before backend rediscovery"
    range 2 20
    default 5
    help
        Consecutive unauthenticated WebSocket disconnects allowed before the
        device retries UDP discovery and replaces its saved endpoint only after
        the discovered backend authenticates successfully.

config FRIDAY_AUDIO_DIGITAL_GAIN
    int "Digital gain applied to streamed microphone PCM"
    range 1 32
    default 8

config FRIDAY_VAD_INITIAL_NOISE_RMS
    int "Initial microphone noise-floor RMS"
    range 1 1000
    default 30

config FRIDAY_VAD_MIN_SPEECH_RMS
    int "Minimum speech-start RMS"
    range 1 32767
    default 50

config FRIDAY_VAD_SPEECH_RATIO_PERCENT
    int "Speech threshold as percent of ambient noise"
    range 100 1000
    default 150

config FRIDAY_VAD_SPEECH_START_MS
    int "Continuous speech required to start a turn (ms)"
    range 20 1000
    default 60

config FRIDAY_VAD_MIN_SILENCE_RMS
    int "Minimum trailing-silence RMS threshold"
    range 1 32767
    default 45

config FRIDAY_VAD_SILENCE_RATIO_PERCENT
    int "Silence threshold as percent of ambient noise"
    range 100 500
    default 135

config FRIDAY_VAD_SILENCE_END_MS
    int "Trailing silence required to submit a turn (ms)"
    range 200 3000
    default 800

config FRIDAY_AEC_BARGE_IN
    bool "Experimental echo-cancelled spoken interruption"
    default n
    help
        Enables 16kHz Espressif AEC using a bounded software playback reference.
        Requires physical reference-delay calibration and acoustic validation.
        Missing reference suppresses microphone frames; half-duplex is default.

config FRIDAY_AEC_REFERENCE_DELAY_MS
    int "Playback reference alignment delay (ms)"
    depends on FRIDAY_AEC_BARGE_IN
    range 0 200
    default 60

endmenu
```

## firmware/sdkconfig.defaults
```kconfig
CONFIG_IDF_TARGET="esp32p4"
CONFIG_ESP32P4_SELECTS_REV_LESS_V3=y
CONFIG_ESP32P4_REV_MIN_100=y
CONFIG_ESPTOOLPY_FLASHSIZE_32MB=y
CONFIG_ESPTOOLPY_FLASHSIZE="32MB"
CONFIG_SPIRAM=y
CONFIG_SPIRAM_MODE_HEX=y
CONFIG_SPIRAM_SPEED_200M=y
CONFIG_SPIRAM_SPEED=200
CONFIG_SPIRAM_XIP_FROM_PSRAM=y
CONFIG_SPIRAM_MALLOC_ALWAYSINTERNAL=0
CONFIG_SPIRAM_MALLOC_RESERVE_INTERNAL=4096
CONFIG_ESP_DEFAULT_CPU_FREQ_MHZ_360=y
CONFIG_FREERTOS_HZ=1000
CONFIG_PARTITION_TABLE_CUSTOM=y
CONFIG_PARTITION_TABLE_CUSTOM_FILENAME="partitions.csv"
CONFIG_LV_OS_FREERTOS=y
CONFIG_LV_USE_CLIB_MALLOC=y
CONFIG_LV_USE_CLIB_STRING=y
CONFIG_LV_USE_CLIB_SPRINTF=y
CONFIG_LV_DEF_REFR_PERIOD=15
CONFIG_LV_OBJ_STYLE_CACHE=y
CONFIG_LV_DRAW_SW_DRAW_UNIT_CNT=2
CONFIG_LV_FONT_MONTSERRAT_18=y
CONFIG_LV_FONT_MONTSERRAT_24=y
CONFIG_LV_FONT_MONTSERRAT_32=y
CONFIG_IDF_EXPERIMENTAL_FEATURES=y
CONFIG_BSP_I2C_CLK_SPEED_HZ=400000
CONFIG_BSP_LCD_DPI_BUFFER_NUMS=3
CONFIG_BSP_LCD_COLOR_FORMAT_RGB565=y
CONFIG_BSP_LCD_TYPE_720_720_4_INCH=y
CONFIG_ESP_WIFI_REMOTE_ENABLED=y
CONFIG_SLAVE_IDF_TARGET_ESP32C6=y
CONFIG_ESP_HOSTED_IDF_SLAVE_TARGET="esp32c6"
CONFIG_ESP_HOSTED_P4_DEV_BOARD_FUNC_BOARD=y
CONFIG_ESP_WS_CLIENT_SEPARATE_TX_LOCK=y
CONFIG_FRIDAY_BACKEND_WS_URI="wss://192.168.4.38:8000/ws/device/friday-p3a"
CONFIG_FRIDAY_DISCOVERY_PORT=8334
CONFIG_FRIDAY_REDISCOVERY_FAILURES=5
CONFIG_FRIDAY_AUDIO_DIGITAL_GAIN=8
CONFIG_FRIDAY_VAD_MIN_SPEECH_RMS=50
CONFIG_FRIDAY_VAD_SPEECH_RATIO_PERCENT=150
```
